## DICMFrameworkConfiguration/configuration/sdkconfig.defaults.project
```kconfig
# partition table
CONFIG_PARTITION_TABLE_CUSTOM=y
CONFIG_PARTITION_TABLE_CUSTOM_FILENAME="DICMFramework/partitions.csv"

#Modem Tx: GPIO_NUM_25 Rx: 39
CONFIG_MODEM_UART_TX_PIN=25
CONFIG_MODEM_UART_RX_PIN=39
CONFIG_MODEM_PPP_AUTH_USERNAME="espressif"
CONFIG_MODEM_PPP_AUTH_PASSWORD="esp32"
CONFIG_MODEM_APN="dometic.cxn"

#CONFIG_FREERTOS_GENERATE_RUN_TIME_STATS=y
#CONFIG_FREERTOS_USE_TRACE_FACILITY=y
#CONFIG_FREERTOS_USE_STATS_FORMATTING_FUNCTIONS=y
#CONFIG_FREERTOS_VTASKLIST_INCLUDE_COREID=y
```

## configuration/sdkconfig.defaults.project
```kconfig
#project config
CONFIG_DICM_TARGET_INVENTILATE_INV_3=y

CONFIG_DICM_TARGET_CUSTOM_H=y
CONFIG_DICM_TARGET_CUSTOM_FILE_H="local_inventilate_inv_3.h"

# partition table
#CONFIG_PARTITION_TABLE_CUSTOM=y
#CONFIG_PARTITION_TABLE_CUSTOM_FILENAME="../../../configuration/partitions.csv"
```
